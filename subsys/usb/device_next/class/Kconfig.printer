## subsys/usb/device_next/class/Kconfig.printer
```kconfig
# Copyright (c) 2022 Nordic Semiconductor ASA
#
# SPDX-License-Identifier: Apache-2.0

config USBD_PRINTER_CLASS
	bool "USB Printer Class"
	help
	  USB device printer class.

if USBD_PRINTER_CLASS
module = USBD_PRINTER
module-str = usbd printer
default-count = 1
source "subsys/logging/Kconfig.template.log_config"

rsource "Kconfig.template.instances_count"
endif
```
